## drivers/i2c/Kconfig.rpi_pico
```kconfig
# Copyright (c) 2024 Florian Weber <Florian.Weber@live.de>
# SPDX-License-Identifier: Apache-2.0

config I2C_RPI_PICO_PIO
	bool "Raspberry Pi PICO PIO I2C controller driver"
	default y
	depends on DT_HAS_RASPBERRYPI_PICO_I2C_PIO_ENABLED
	select PICOSDK_USE_PIO
	select PICOSDK_USE_CLAIM
	help
	  Enable driving I2C via PIO on the PICO
```

## dts/bindings/i2c/raspberrypi,pico-i2c-pio.yaml
```yaml
# Copyright (c) 2023 Stephen Boylan <stephen.boylan@beechwoods.com>
# SPDX-License-Identifier: Apache-2.0

description: Raspberry Pi Pico i2c via PIO

compatible: "raspberrypi,pico-i2c-pio"

include: ["i2c-controller.yaml", "raspberrypi,pico-pio-device.yaml", "reset-device.yaml"]

properties:
  sda-gpios:
    type: phandle-array
    required: true
    description: |
      I/O pin for data

  scl-gpios:
    type: phandle-array
    required: true
    description: |
      I/O pin for clock

  clocks:
    required: true
```
